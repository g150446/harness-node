## nrf52-handy/sysbuild/mcuboot/boards/xiao_ble_nrf52840_sense.conf
```kconfig
# MCUboot board config for XIAO nRF52840 Sense

# Standard nRF52840 internal flash driver
CONFIG_FLASH=y

# Support large application images
CONFIG_BOOT_MAX_IMG_SECTORS=256

# Disable USB in MCUboot (not needed, saves space)
CONFIG_USB_DEVICE_STACK=n

# Disable watchdog feeding
CONFIG_BOOT_WATCHDOG_FEED=n

# Stack protection not needed in MCUboot
CONFIG_HW_STACK_PROTECTION=n
```

## nrf54-speaker/sysbuild/mcuboot/boards/xiao_nrf54l15_nrf54l15_cpuapp.conf
```kconfig
# MCUboot board config for XIAO nRF54L15
# Based on official NCS nrf54l15dk_nrf54l15_cpuapp.conf (FPROTECT not yet supported)

# Disable flash write protection - not yet supported on nRF54L15 in MCUboot
CONFIG_FPROTECT=n

# Enable RRAM flash driver explicitly (required when FPROTECT=n to keep FLASH_HAS_DRIVER_ENABLED)
CONFIG_FLASH=y
CONFIG_SOC_FLASH_NRF_RRAM=y
# Disable nrfx RRAMC - it enables IRQ 75 which may interfere with MCUboot boot
CONFIG_NRFX_RRAMC=n

# Skip RRAMC READYNEXTTIMEOUT register write (causes CPU exception on XIAO nRF54L15)
CONFIG_NRF_RRAM_READYNEXT_TIMEOUT_VALUE=0

# Disable GRTC and SysTick system clock for MCUboot
# SysTick is enabled by sys_clock_driver_init but has no proper handler, causing faults
CONFIG_NRF_GRTC_TIMER=n
CONFIG_NRF_GRTC_START_SYSCOUNTER=n
CONFIG_SYS_CLOCK_EXISTS=n

# Disable SPI NOR driver (causes build failures without DTS config)
CONFIG_SPI_NOR=n

# Disable watchdog feeding (not needed for MCUboot on XIAO)
CONFIG_BOOT_WATCHDOG_FEED=n

# Disable ARM MPU and stack guard to prevent init crashes
CONFIG_ARM_MPU=n
CONFIG_HW_STACK_PROTECTION=n
CONFIG_BUILTIN_STACK_GUARD=n

# Support large application images
CONFIG_BOOT_MAX_IMG_SECTORS=256

# Disable dynamic malloc arena to avoid crash with large arena allocation
CONFIG_COMMON_LIBC_MALLOC_ARENA_SIZE=0
```
