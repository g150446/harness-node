## sdkconfig.defaults
```kconfig
# Shared defaults; target-specific files:
#   sdkconfig.defaults.esp32   -> StickC Plus2
#   sdkconfig.defaults.esp32s3 -> Atom Echo S3R
# Select board component with -DHN_BOARD=stickc_plus2|atom_echo_s3r

CONFIG_BT_ENABLED=y
CONFIG_BT_NIMBLE_ENABLED=y
```

## sdkconfig.defaults.esp32
```kconfig
# M5StickC Plus2 (ESP32-PICO-V3-02)
CONFIG_IDF_TARGET="esp32"
CONFIG_ESPTOOLPY_FLASHSIZE_8MB=y
CONFIG_ESPTOOLPY_FLASHSIZE="8MB"
# Dual OTA slots (see stickc_plus2/partitions_ota.csv)
CONFIG_PARTITION_TABLE_CUSTOM=y
CONFIG_PARTITION_TABLE_CUSTOM_FILENAME="stickc_plus2/partitions_ota.csv"
CONFIG_PARTITION_TABLE_FILENAME="stickc_plus2/partitions_ota.csv"
CONFIG_BOOTLOADER_APP_ROLLBACK_ENABLE=y
CONFIG_BOOTLOADER_APP_ANTI_ROLLBACK=n

# PSRAM
CONFIG_ESP32_SPIRAM_SUPPORT=y
CONFIG_SPIRAM=y
CONFIG_SPIRAM_BOOT_INIT=y
CONFIG_SPIRAM_USE_MALLOC=y

# BLE NimBLE
CONFIG_BT_ENABLED=y
CONFIG_BT_NIMBLE_ENABLED=y
CONFIG_BT_NIMBLE_ROLE_BROADCASTER=y
CONFIG_BT_NIMBLE_ROLE_PERIPHERAL=y
CONFIG_BT_NIMBLE_HOST_TASK_STACK_SIZE=4096
CONFIG_BT_NIMBLE_MAX_CONNECTIONS=2
# 16 kHz PCM at ~160 notifications/s drains 12 blocks instantly (os_memblock_get
# failed + dropped audio). Sized to absorb bursts while the link drains.
CONFIG_BT_NIMBLE_MSYS_1_BLOCK_COUNT=48
CONFIG_BT_NIMBLE_ATT_PREFERRED_MTU=512
CONFIG_BT_NIMBLE_SVC_GAP_DEVICE_NAME="HarnessNode-Plus2"
CONFIG_BT_CONTROLLER_ENABLED=y
CONFIG_BTDM_CTRL_MODE_BLE_ONLY=y

# Console via CH9102 UART
CONFIG_ESP_CONSOLE_UART_DEFAULT=y
CONFIG_ESP_CONSOLE_UART_BAUDRATE=115200

# Logs (keep bootloader small)
CONFIG_LOG_DEFAULT_LEVEL_INFO=y
CONFIG_LOG_DEFAULT_LEVEL=3
CONFIG_BOOTLOADER_LOG_LEVEL_WARN=y
CONFIG_BOOTLOADER_LOG_LEVEL=2
```
